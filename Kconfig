## boards/shields/2x3pad/Kconfig.defconfig
```kconfig
if SHIELD_2X3PAD

config ZMK_KEYBOARD_NAME
    string "2x3 Pad"
    default "2x3Pad"
endif
```

## boards/shields/hexaboard/Kconfig.defconfig
```kconfig
if SHIELD_HEXABOARD

config ZMK_KEYBOARD_NAME
    string "Hexaboard"
    default "Hexaboard"
endif
```

## boards/shields/hexaboard/boards/seeeduino_xiao_ble.conf
```kconfig
# Copyright (c) 2025 The ZMK Contributors
# SPDX-License-Identifier: MIT

CONFIG_SOC_SERIES_NRF52X=y
CONFIG_SOC_NRF52840_QIAA=y
CONFIG_BOARD_XIAO_NRF52840=y

# Enable MPU
CONFIG_ARM_MPU=y

# Enable GPIO
CONFIG_GPIO=y

# Enable USB
CONFIG_USB=y
CONFIG_ZMK_USB=y

# Enable bluetooth
CONFIG_ZMK_BLE=y

# Enable encoder
CONFIG_EC11=n
CONFIG_EC11_TRIGGER_GLOBAL_THREAD=n

# Enable underglow
CONFIG_ZMK_RGB_UNDERGLOW=n
CONFIG_WS2812_STRIP=n

# Enable display
CONFIG_ZMK_DISPLAY=y

# I2C and SSD1306 configuration
CONFIG_I2C=y
CONFIG_SSD1306=y

# Display settings
CONFIG_ZMK_DISPLAY_BLANK_ON_IDLE=n
CONFIG_ZMK_WIDGET_BATTERY_STATUS=y
CONFIG_ZMK_WIDGET_BATTERY_STATUS_SHOW_PERCENTAGE=y
```

## boards/shields/hexaboard/boards/xiao_ble.conf
```kconfig
# Copyright (c) 2025 The ZMK Contributors
# SPDX-License-Identifier: MIT

# Enable MPU
CONFIG_ARM_MPU=y

# Enable GPIO
CONFIG_GPIO=y

# Enable USB
CONFIG_ZMK_USB=y

# Enable bluetooth
CONFIG_ZMK_BLE=y

# Enable encoder
CONFIG_EC11=n
CONFIG_EC11_TRIGGER_GLOBAL_THREAD=n

# Enable underglow
CONFIG_ZMK_RGB_UNDERGLOW=n

# Enable display
CONFIG_ZMK_DISPLAY=y

# I2C and SSD1306 configuration
CONFIG_I2C=y
CONFIG_SSD1306=y

# Display settings
CONFIG_ZMK_DISPLAY_BLANK_ON_IDLE=n
CONFIG_ZMK_WIDGET_BATTERY_STATUS=y
CONFIG_ZMK_WIDGET_BATTERY_STATUS_SHOW_PERCENTAGE=y
```

## boards/shields/hexaboard/hexaboard.conf.defconfig
```kconfig
# Copyright (c) 2025 The ZMK Contributors
# SPDX-License-Identifier: MIT

CONFIG_SOC_SERIES_NRF52X=y
CONFIG_SOC_NRF52840_QIAA=y
CONFIG_BOARD_XIAO_NRF52840=y

# Enable MPU
CONFIG_ARM_MPU=y

# Enable GPIO
CONFIG_GPIO=y

# Enable USB
CONFIG_USB=y
CONFIG_ZMK_USB=y

# Enable bluetooth
CONFIG_ZMK_BLE=y

# Enable encoder
CONFIG_EC11=n
CONFIG_EC11_TRIGGER_GLOBAL_THREAD=n

# Enable underglow
CONFIG_ZMK_RGB_UNDERGLOW=n
CONFIG_WS2812_STRIP=n
```
